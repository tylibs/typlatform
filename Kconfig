## Kconfig
```kconfig
choice TY_PLATFORM
	prompt "BUILD System"
	default ESP_PLATFORM if IDF_CMAKE
	default ZEPHYR_PLATFORM if ZEPHYR_CMSIS_MODULE
	help
		Use this option in Kconfig to select in if statement the platform to build for.
config ZEPHYR_PLATFORM
	bool "Zephyr"
	help
		Zephyr RTOS platform.
config ESP_PLATFORM
	bool "ESP"
	help
		ESP32 platform.
endchoice

menu "Tiny configuration"

	config TY_LOG
		bool "Enable logging"
		default "y"
		help
			Selects whether tinyplatform logs messages.

	config TY_ASSERTS
		bool "Enable asserts"
		default "y"
		help
			Selects whether tinyplatform performs runtime assert checks.
choice TY_LOG_LEVEL_CHOICE
	prompt "Tiny stack log level"
	depends on TY_DEBUG
	help
	  This option selects log level for Tiny stack.

config TY_LOG_LEVEL_CRIT
	bool "Critical"
config TY_LOG_LEVEL_WARN
	bool "Warning"
config TY_LOG_LEVEL_NOTE
	bool "Notice"
config TY_LOG_LEVEL_INFO
	bool "Informational"
config TY_LOG_LEVEL_DEBG
	bool "Debug"
endchoice # TY_LOG_LEVEL_CHOICE

config TY_LOG_LEVEL
	int
	default 1 if TY_LOG_LEVEL_CRIT
	default 2 if TY_LOG_LEVEL_WARN
	default 3 if TY_LOG_LEVEL_NOTE
	default 4 if TY_LOG_LEVEL_INFO
	default 5 if TY_LOG_LEVEL_DEBG
	default 4
	help
	  Log level for Tiny stack.


endmenu
```
